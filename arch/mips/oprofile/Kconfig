## drivers/media/dvb/dibusb/Kconfig
```kconfig
config DVB_DIBUSB
	tristate "DiBcom USB DVB-T devices (see help for a complete device list)"
	depends on DVB_CORE && USB
	select FW_LOADER
#	select DVB_DIB3000MB
#	select DVB_DIB3000MC
#	select DVB_MT352
	help
	  Support for USB 1.1 and 2.0 DVB-T devices based on reference designs made by
	  DiBcom (http://www.dibcom.fr) and C&E.

	  Devices supported by this driver:
	    Realtek DVB-T USB (RTL2830/RTL2831U)

	  These devices can be understood as budget ones, they "only" deliver
	  (a part of) the MPEG2 transport stream.

	  A firmware is needed to get the device working. See Documentation/dvb/README.dibusb
	  details.

	  Say Y if you own such a device and want to use it. You should build it as
	  a module.

#config DVB_DIBUSB_MISDESIGNED_DEVICES
#	bool "Enable support for some misdesigned (see help) devices, which identify with wrong IDs"
#	depends on DVB_DIBUSB
#	help
#	  Somehow Artec/Ultima Electronic forgot to program the eeprom of some of their
#	  USB1.1/USB2.0 devices.
#	  So comes that they identify with the default Vendor and Product ID of the Cypress
#	  CY7C64613 (AN2235) or Cypress FX2.
#
#	  Affected device IDs:
#	    0x0574:0x2235 (Artec T1 USB1.1, cold)
#	    0x04b4:0x8613 (Artec T1 USB2.0, cold)
#	    0x0574:0x1002 (Artec T1 USB2.0, warm)
#	    0x0574:0x2131 (aged DiBcom USB1.1 test device)
#
#	  Say Y if your device has one of the mentioned IDs.

#config DVB_DIBCOM_DEBUG
#	bool "Enable extended debug support for DiBcom USB device"
#	depends on DVB_DIBUSB
#	help
#	  Say Y if you want to enable debuging. See modinfo dvb-dibusb for
#	  debug levels.
```

## drivers/net/uwb/Kconfig
```kconfig
#
# UWB wireless LAN device configuration
#

menu "UWB wireless LAN"
	depends on NETDEVICES

config NET_UWB
	bool "UWB wireless LAN drivers"
	---help---
	  UWB wireless LAN drivers

comment "Realtek UWB wireless LAN drivers"
	depends on NET_UWB

config REALTEK_USB_RTU7300
	tristate "Realtek RTU7300 UWB usb driver"
	depends on NET_UWB && USB
	---help---
	  Say Y if you want to use it.

endmenu
```

## drivers/net/wireless/realtek/Kconfig
```kconfig
menu "Reaktek 802.11x wireless lan devices"	
	depends on NET_RADIO

config REALTEK_PCI_RTL8185
       	tristate "Realtek RTL8185 chipset 802.11g support (PCI)"
	depends on NET_RADIO && INET && PCI
	select REALTEK_IEEE80211
	---help---
	  Say Y if you have a PCI 802.11g device with Realtek RTL8185
	  chipset.		 

config REALTEK_USB_RTL8187
       	tristate "Realtek RTL8187 chipset 802.11g support (USB)"
	depends on NET_RADIO && INET && USB
	select REALTEK_IEEE80211
	---help---
	  Say Y if you have a PCI 802.11g device with Realtek RTL8187
	  chipset.		 

config REALTEK_PCI_RTL8190
       	tristate "Realtek RTL8190 chipset 802.11n support (PCI)"
	depends on NET_RADIO && INET && PCI
	---help---
	  Say Y if you have a PCI 802.11n device with Realtek RTL8190
	  chipset.

#config REALTEK_USB_RTL8709
#       	tristate "Realtek RTL8709 chipset 802.11n support (USB)"
#       	depends on NET_RADIO && INET && USB        
#       	---help---
#         Say Y if you have a USB 802.11n device with Realtek RTL8709
#         chipset.

config REALTEK_USB_RTL8192
       	tristate "Realtek RTL8192 chipset 802.11n support (USB)"
       	depends on NET_RADIO && INET && USB        
       	---help---
         Say Y if you have a USB 802.11n device with Realtek RTL8192
         chipset.

config REALTEK_USB_RTL8191SU
       	tristate "Realtek RTL8191SU chipset 802.11n support (USB)"
       	depends on NET_RADIO && INET && USB        
       	---help---
         Say Y if you have a USB 802.11n device with Realtek RTL8191SU
         chipset.

endmenu
```

## drivers/smartcard/adapter/Kconfig
```kconfig
# drivers/Kconfig

comment"Smart Card Interface"
	depends on SMARTCARD

config MARS_SMARTCARD_IFD
	tristate "MARS Smart Card Interface"
	depends on SMARTCARD && REALTEK_VENUS
	default n
	help
	  If you want to use smart card on Mars board, say Y.
```

## drivers/usb/gadget/realtek/Kconfig
```kconfig
config USB_OTG_REALTEK
	tristate "Realtek USB OTG Controller"
	depends on USB_GADGET	
	help
		"Dual-Role" device, which can act as either a device
		or a host.  The initial role choice can be changed
		later, when two dual-role devices talk to each other.
		
		Select this only if your Realtek board has a Mini-AB connector.

		
```

## drivers/usb/gadget/realtek/Kconfig.options
```kconfig
menu "Realtek USB OTG Controller Configuration"
	depends on USB_GADGET && USB_OTG_REALTEK
		   	   		              
config USB_GADGET_DUALSPEED
	bool "Support High Speed Mode"
	depends on USB_OTG_REALTEK
	default Y
	help
	  Means that gadget drivers should include extra descriptors
	  and code to handle dual-speed controllers.
	  
	  Select "y" if you want support high speed mode device.  
  
choice
	prompt "Mode Configuration"
	depends on USB_GADGET && USB_OTG_REALTEK
	help
	   Realtek USB OTG controller has tree kind of mode configurations.
	   You can choice one of mode configuration in compile time.
	   	 
config USB_OTG_REALTEK_OTG_MODE
	bool "OTG mode"
	depends on USB_OTG_REALTEK
	default Y
	help
	  Support OTG/Host/Device mode.	   	 
	   	  
config USB_OTG_REALTEK_HOST_ONLY_MODE
	bool "Host only mode"
	depends on USB_OTG_REALTEK
	default n
	help
	  Host mode only.	
	  
config USB_OTG_REALTEK_DEVICE_ONLY_MODE
	bool "Device only mode"
	depends on USB_OTG_REALTEK
	default n
	help
	  Device mode only.	
	      
endchoice

config USB_OTG_REALTEK_TEST_SUPPORT
	bool "Support HS Electrical Test Function"
	depends on USB_OTG_REALTEK
	default Y
	help
	  Quick and dirty hack to implement the HS Electrical Test
	  SINGLE_STEP_GET_DEVICE_DESCRIPTOR feature.
	  		
endmenu	
	   
```

## drivers/usb/gadget/realtek/verify/Kconfig
```kconfig
config USB_OTG_REALTEK_DEVICE_VERIFY_DRIVER
	tristate "Realtek USB OTG Device Verify Driver"
	depends on USB_OTG_REALTEK	
	help
		Realtek USB OTG device verify driver for H/W verification.
		
		Select this only if your want Realtek USB OTG device verify driver support.
```
