## arch/mips/oprofile/Kconfig
```kconfig
menu "Profiling support"
	depends on EXPERIMENTAL

config PROFILING
	bool "Profiling support (EXPERIMENTAL)"
	help
	  Say Y here to enable the extended profiling support mechanisms used
	  by profilers such as OProfile.


config OPROFILE
	tristate "OProfile system profiling (EXPERIMENTAL)"
	depends on PROFILING && EXPERIMENTAL
	help
	  OProfile is a profiling system capable of profiling the
	  whole system, include the kernel, kernel modules, libraries,
	  and applications.

	  If unsure, say N.

config VENUS_OPROFILE_CLOCK
	bool "Use Venus CPU clock for oprofile"
	depends on OPROFILE && PROFILING && EXPERIMENTAL
	help
	  Use Venus's CPU clock to drive oprofile, instead of the default
	  scheduler timer interrupt. The CPU clock can drive sampling rate
	  at 2500 (default, changable) per second, compared to 100 sampling
	  per second (fixed) for default timer.

config VENUS_OPROFILE_FREQ
	int "Venus oprofile sampling frequency" 
	depends on VENUS_OPROFILE_CLOCK
	default "2500"
	help
	   Sampling frequency of Oprofile using Venus internal clock.
endmenu
```

## arch/mips/realtek-boards/Kconfig
```kconfig
config REALTEK_RTOS_MEMORY_SIZE
	hex "RTOS memory size"
	depends on REALTEK_VENUS
	default "0x400000"
	help
	  RTOS needs some RAM for running.

config REALTEK_DETERMINE_SYSTEM_CPU_CLOCK_FREQUENCY
	bool "Determine System CPU clock frequency in advance"
	depends on REALTEK_VENUS

config REALTEK_SYSTEM_CPU_CLOCK_FREQUENCY                                                 
	int "System CPU clock frequency" if REALTEK_DETERMINE_SYSTEM_CPU_CLOCK_FREQUENCY
	depends on REALTEK_DETERMINE_SYSTEM_CPU_CLOCK_FREQUENCY
	default "202500000"
	help
	  System CPU clock frequency. This is used to compute the Linux
	  time, and it should be synced with RTC time from time to time.
	  For Venus, it's default value is 202500000. If this value is not
	  set, Linux will estimate it and doing this will waste over 0.5  
	  second in time.c.

config REALTEK_SYSTEM_OWNS_SECOND_UART
	bool "If SYSTEM CPU owns the second UART port"
	depends on REALTEK_VENUS
	default y
	help
	  Sometimes the second UART is used by Audio or Video CPU.

config REALTEK_SYSTEM_UART_BE_READONLY
	bool "If SYSTEM uart be readonly"
	depends on REALTEK_VENUS
	default n
	help
	  If this is chosen, uart doesn't accept any char inputed by user.

config REALTEK_USE_EXTERNAL_TIMER_INTERRUPT
	bool "Y to use external timer interrupt; n to use internal timer interrupt."
	depends on REALTEK_VENUS
	default y
	help
	  External timer interrupt is more reliable.

config REALTEK_COMPACT
	bool "Build up a smallest kernel."
	depends on REALTEK_VENUS
	default n
	help
	  Strip anything that isn't necessary.

source "arch/mips/realtek-boards/drivers/Kconfig"

menu "Realtek performance facility"
        depends on REALTEK_VENUS

choice
        prompt "Shadow Registers or DMEM"
        default REALTEK_USE_SHADOW_REGISTERS

config REALTEK_NO_SHADOW_REGISTERS
	bool "No Use"
	depends on REALTEK_VENUS
	help
	  Don't use any shadow registers.

config REALTEK_USE_SHADOW_REGISTERS
	bool "General Use"
	depends on REALTEK_VENUS
	help
	  Use shadow registers to accelerate the interrupt handling.

config REALTEK_USE_FAST_INTERRUPT
	bool "Fast Interrupt"
	depends on REALTEK_VENUS
	help
	  Use fast interrupt to handle USB interrupt.

config REALTEK_USE_DMEM
	bool "DMEM"
	depends on REALTEK_VENUS
	help
	  Use DMEM as stack to accelerate the interrupt handling.

endchoice

config REALTEK_DISABLE_BOOT_HOTPLUG
	bool "Disable boot-up hotplug."
	depends on REALTEK_VENUS
	default y
	help
	  This will disable the hotplug during linux kernel boot-up. During 
	  linux kernel boot-up, the root filesystem has not been mounted yet.

config REALTEK_OPEN_CU0
	bool "Allow userland application access cpu register directly."
	depends on REALTEK_VENUS
	default n
	help
	  Use this function allow application to use some kernel function.

config REALTEK_MAP_IO_REGISTERS
	bool "Map io registers into user space."
	depends on REALTEK_VENUS
	default n
	help
	  Map io registers.

config REALTEK_RECLAIM_BOOT_MEM
	bool "Reclaim the memory used by boot loader."
	depends on REALTEK_VENUS
	default n
	help
	  Reclain the memory used by boot loader.

config REALTEK_ADVANCED_RECLAIM
	bool "Buddy system will allocate memory more efficiently."
	depends on REALTEK_VENUS
	default n
	help
	  Buddy system will allocate memory more efficiently.

config REALTEK_SCHED_LOG
	bool "Log the scheduling sequence."
	depends on REALTEK_VENUS
	default n
	help
	  Log the scheduling sequence.

config REALTEK_DETECT_OCCUPY
	bool "Detect if one thread occupy CPU too long."
	depends on REALTEK_VENUS
	default n
	help
	  Detect if one thread occupy CPU too long.

config REALTEK_SBSS_IN_DMEM
	bool "Put the .sbss section in DMEM."
	depends on REALTEK_VENUS
	default n
	help
	  Put the .sbss section in DMEM.

config REALTEK_SBSS_IN_DMEM_ADVANCED
	bool "Put more data in the .sbss section."
	depends on REALTEK_SBSS_IN_DMEM
	default n
	help
	  Put more data in .sbss section. This option should be opened only in Mars.
endmenu

menu "Realtek debug facility"
        depends on REALTEK_VENUS

choice
	prompt "SB2 software debug mode"
	default REALTEK_MEMORY_DEBUG_MODE

config REALTEK_NO_SB2_DEBUG
	bool "No Use"
	depends on REALTEK_VENUS
	help
	  Don't use any shadow registers.

config REALTEK_TEXT_DEBUG
	bool "Protect all text segments from being trashed."
	depends on REALTEK_VENUS
	help
	  Protect all text segments from being trashed.
	  This will use software debug register 7.

config REALTEK_TEXT_SIZE
	int "Define the TEXT zone size."
	depends on REALTEK_VENUS && REALTEK_TEXT_DEBUG
	default 2
	help
	  This will define the zone size (in MBs) of TEXT.

config REALTEK_MEMORY_DEBUG_MODE
	bool "Enable the memory debug mode."
	depends on REALTEK_VENUS 
	help
	  This mode is used to detect if there is memory trash.
	  This will use software debug register 5, 6, 7.
	  The memory should be 128MB or above.

config REALTEK_USER_DEBUG
	bool "User can define the protected sections by themself."
	depends on REALTEK_VENUS
	help
	  User can define the protected sections by themself.
endchoice

config REALTEK_WATCHPOINT
	bool "Use watchpoint to debug."
	depends on REALTEK_VENUS
	default n
	help
	  Use hardware watchpoint.

config REALTEK_ENABLE_ADE
	bool "Kernel won't handle automatically unaligned access."
	depends on REALTEK_VENUS
	default n
	help
	  Kernel won't handle automatically unaligned access.

config REALTEK_SHOW_STACK
        bool "Enable the debug facility of showing task stack."
        depends on REALTEK_VENUS
        default n
        help
          Enable the debug facility of showing task stack.

config REALTEK_SHOW_MALLOC_SIZE
        bool "Enable the debug facility of showing the size of malloc()."
        depends on REALTEK_VENUS
        default n
        help
          Enable the debug facility of showing the size of malloc().

config REALTEK_MONITOR_PAGE
	bool "Monitor all the ide actions operated on specified page."
	depends on REALTEK_VENUS
	default n
	help
	  Monitor all the ide actions operated on specified page.

config REALTEK_PROC_RAMFS
	bool "List all the regular files in ramfs."
	depends on REALTEK_VENUS
	default n
	help
	  List all the regular files in ramfs.

config REALTEK_PLI_DEBUG_MODE
	bool "Dynamically map the memory allocated by PLI."
	depends on REALTEK_VENUS
	default n
	help
	  Dynamically map the memory allocated by PLI.
endmenu

config REALTEK_WATCHDOG
        bool "Use watchdog mechanism."
        depends on REALTEK_VENUS
        default n
        help
          System will automatically be rebooted if watchdog doesn't respond in 1.5 seconds.

config REALTEK_RESERVE_DVR
        bool "Reserve the DVR zone after boot-up."
        depends on REALTEK_VENUS
        default n
        help
          Reserve the DVR zone after boot-up.

config REALTEK_SUPPORT_BOOT_AV
        bool "Reverse the DVR zone before enter power-off state."
        depends on REALTEK_VENUS && REALTEK_RESERVE_DVR
        default n
        help
          Reserve the DVR zone before enter power-off state. This function can support the boot-up audio & video.

config REALTEK_PCI_SUPPORT
        bool "Enable the PCI controller."
        depends on REALTEK_VENUS
        default n        
        select HW_HAS_PCI
	select REALTEK_PCI_2883
        help
          Enable the PCI functionarity of VENUS.	
          
config REALTEK_PCI_2883
	bool         
 
choice
        prompt "Support the HDMI function for 1071"
        default REALTEK_HDMI_NONE

config REALTEK_HDMI_NONE
        bool "Not support."
        depends on REALTEK_VENUS
        help
          Not support.

config REALTEK_HDMI_NXP
	bool "Support NXP chip."
	depends on REALTEK_VENUS
	help
	  Support NXP chip.

config REALTEK_HDMI_CAT
	bool "Support CAT chip."
	depends on REALTEK_VENUS
	help
	  Support CAT chip.

endchoice

config REALTEK_PREVENT_DC_ALIAS
	bool "Prevent the virtual alias problem."
	depends on REALTEK_VENUS
	default n
	help
	  If we need to prevent the virtual alias problem.

config REALTEK_MARS_256MB
	bool "Support the 256MB in Mars."
	depends on REALTEK_VENUS
	default n
	help
	  In order to support the 256MB in Mars.

config REALTEK_MARS_RESERVE_LAST_48MB
	bool "Reserve the last 48MB for AVC high-level 5.1."
	depends on REALTEK_VENUS && REALTEK_MARS_256MB
	default n
	help
	  Video firmware can use the last 48MB to decode the high-level 5.1.

config REALTEK_SECURE_BOOT_PARTITION
	bool "Secure partition support"
	select REALTEK_MCP
	default n
	help
	  Kernel will check if the hash value of some partition is matched
	  with the value passed from bootloader before running init. If the
	  partition is modified, kernel will know that.

	  The format of the parameter will be like this:
	  partition_hash="[partition num]:[partition size]:[hash value]
```

## arch/mips/realtek-boards/drivers/Kconfig
```kconfig
menu "Uncatalogued drivers"
	depends on REALTEK_VENUS

config REALTEK_IR
	tristate "IR Receiver Driver"
	depends on REALTEK_VENUS
	default m
	help
	  IR Receiver Character Device Driver
config REALTEK_VFD
	tristate "VFD Driver"
	depends on REALTEK_VENUS
	default m
	help
	  VFD Control Character Device Driver
config REALTEK_GPIO
	tristate "GPIO Driver"
	depends on REALTEK_VENUS
	default n
	help
	  GPIO Device Driver
config REALTEK_I2CSLAVE
        tristate "I2C Slave Driver"
        depends on REALTEK_VENUS && (!I2C)
        default n
        help
          I2C Slave Device Driver
config REALTEK_GPIO_RESCUE_FOR_PC_INSTALL
	tristate "GPIO Driver for rescue kernel to install from PC"
	depends on REALTEK_GPIO
	default n
	help
	  GPIO Device Driver for Rescue Kernel
config REALTEK_SE
	tristate "SE Driver"
	depends on REALTEK_VENUS
	default m
	help
	  Streaming Engine Driver
config REALTEK_RPC
        tristate "Use RPC to communicate with lx5280."
        depends on REALTEK_VENUS
        default m
        help
          Use RPC mechanism

endmenu
```

## drivers/Kconfig
```kconfig
# drivers/Kconfig

menu "Device Drivers"

source "drivers/base/Kconfig"

source "drivers/mtd/Kconfig"

source "drivers/parport/Kconfig"

source "drivers/pnp/Kconfig"

source "drivers/block/Kconfig"

source "drivers/ide/Kconfig"

source "drivers/scsi/Kconfig"

source "drivers/cdrom/Kconfig"

source "drivers/md/Kconfig"

source "drivers/message/fusion/Kconfig"

source "drivers/ieee1394/Kconfig"

#config IEEE1394_VENUS
#	tristate "IEEE1394 driver for Venus board"
#	depends on REALTEK_VENUS
#	default y
#	help
#	  If you want to enable 1394 on Venus board, say Y.

source "drivers/message/i2o/Kconfig"

source "drivers/macintosh/Kconfig"

source "net/Kconfig"

source "drivers/isdn/Kconfig"

source "drivers/telephony/Kconfig"

# input before char - char/joystick depends on it. As does USB.

source "drivers/input/Kconfig"

source "drivers/char/Kconfig"

source "drivers/i2c/Kconfig"

source "drivers/w1/Kconfig"

source "drivers/misc/Kconfig"

source "drivers/media/Kconfig"

source "drivers/video/Kconfig"

source "sound/Kconfig"

source "drivers/usb/Kconfig"

source "drivers/mmc/Kconfig"

source "drivers/infiniband/Kconfig"

source "drivers/cec/Kconfig"

source "drivers/ci/Kconfig"

source "drivers/smartcard/Kconfig"

config THIRD_PARTY_DRIVER
	bool "3 party drivers that don't reside in Linux kernel source tree"
	help
	  3 party drivers that don't reside in Linux kernel source tree.

config THIRD_PARTY_DRIVER_LIST
	string "The list of 3 party drivers" if THIRD_PARTY_DRIVER
	depends on THIRD_PARTY_DRIVER
	help
	  We can add 3 party drivers to the list.

endmenu
```

## drivers/cec/Kconfig
```kconfig
# drivers/cec/Kconfig

menu "CEC Support"

source drivers/cec/core/Kconfig
source drivers/cec/adapter/Kconfig

endmenu
	
```

## drivers/cec/adapter/Kconfig
```kconfig
# drivers/Kconfig

comment"CEC Adapters"
	depends on CEC

config MARS_CEC
	bool "NEPTUNE/MARS CEC Controller"
	depends on CEC && REALTEK_VENUS
	default n
	help
	  If you want to use CEC on Neptune/Mars board, say Y.
```

## drivers/cec/core/Kconfig
```kconfig
# drivers/cec/core/Kconfig

config CEC
	bool "CEC Support"
	
config CEC_CHARDEV
	tristate "CEC device interface"
	depends on CEC
	help
	  Say Y here to use cec-* device files, usually found in the /dev/cec/
	  directory on your system.  They make it possible to have user-space
	  programs use the CEC bus.

	  This support is also available as a module.  If so, the module 
	  will be called cec-dev.

	  You will also need to select one of the CEC adapters from the list below.
	

config CEC_DEBUG
	bool "CEC Debug Mode"
	depends on CEC_CHARDEV
	default n
	help 
	  If you want to enable cec debug message, say Y.
```

## drivers/ci/Kconfig
```kconfig
#
# Character device configuration
#

menu "Common interface(CI) options"

config MARS_PCMCIA
	tristate "PCMCIA support"
	---help---
	  Say Y here if you want to enable the PCMCIA interface and driver. 

config MARS_PCMCIA_SLOT_NUM
        int "PCMCIA slot number (1, 2)"
        depends on MARS_PCMCIA
        default "1"
        ---help---
          Determines how many PCMCIA interfaces exist.

config MARS_DEBUG_PC
        bool "PCMCIA debugging messages"
        depends on MARS_PCMCIA
        ---help---
          Say Y here if you want the PCMCIA driver to produce the debug messages to console.

config EN50221
	bool "CI driver support (EN50221)"
	depends on MARS_PCMCIA
	help
	  Say Y here if you want to enable Common Interface driver.

config MARS_DEBUG_CI
        bool "CI driver debugging messages"
        depends on MARS_PCMCIA
        ---help---
          Say Y here if you want the EN50221 driver to produce the debug messages to console.

endmenu
```
